## dts/bindings/zmk,input-processor-abs-to-rel.yaml
```yaml
# Copyright (c) 2025 The ZMK Contributors
# SPDX-License-Identifier: MIT

description: Converts INPUT_ABS_X/Y events to INPUT_REL_X/Y deltas

compatible: "zmk,input-processor-abs-to-rel"

include: ip_zero_param.yaml

properties:
  max-delta:
    type: int
    default: 0
    description: |
      Clamp per-tick delta to ±max-delta raw units. 0 = unlimited.
      Use to cap cursor speed so a fast fling doesn't overshoot the screen.
```

## dts/bindings/zmk,input-processor-gestures.yaml
```yaml
# Copyright (c) 2021 The ZMK Contributors
# SPDX-License-Identifier: MIT

description: Several gestures for touchpads

compatible: "zmk,input-processor-gestures"

include: ip_zero_param.yaml

properties:
  tap-detection:
    type: boolean
    description: |
      A touch that doesn't last longer than tap-timout-ms is interpreted as a tap (click).
  tap-timout-ms:
    type: int
    default: 120
    description: |
      A lower value requires a quicker tap motion, but reduces accidental taps for short movements. 
      The default value is a good compromise that works for me.
  prevent_movement_during_tap:
    type: boolean
    description: |
      While determining if the beginning of a touch is a tap, ignore all other movements.
      This prevents accidental movement aways from the tap-target, but it makes the 
      beginning of regular touches more sluggish.
  
  inertial-cursor:
    type: boolean
    description: |
      If the cursor moves faster than inertial-cursor-velocity-threshold-ms when the touch ends, the cursor 
      keeps moving in  the same direction, gradually getting slower by inertial-cursor-decay-percent.
  inertial-cursor-velocity-threshold:
    type: int
    default: 20
    description: |
      Minimum velocity (in tenths of raw_px/ms) to trigger inertial cursor.
      0 = always trigger. 3 = 0.3 raw_px/ms (filters imperceptible lifts only).
      20 = 2.0 raw_px/ms (old default, requires a noticeable flick).
  inertial-cursor-decay-percent:
    type: int
    default: 30
    description: |
      A lower value will make the cursor move longer after the touch ends - kinda like changing the friction that
      slows down the cursor.
      The default value mimics a relatively high friction.
  inertial-cursor-speed-scale:
    type: int
    default: 100
    description: |
      Percentage applied to the inertial cursor starting velocity so it matches
      the live cursor speed. Set this to the numerator of your zip_xy_scaler to
      compensate for the scaler being bypassed during inertial animation.
      E.g. if using "zip_xy_scaler 75 100", set to 75.

  hold-layer:
    type: int
    default: -1
    description: |
      Layer to activate while a finger is on the touchpad (touch start) and deactivate when lifted.
      Set to -1 (default) to disable.

  inertial-scroll:
    type: boolean
    description: |
      If the scroll moves faster than inertial-scroll-velocity-threshold when the touch ends, scrolling
      keeps going in the same direction, gradually slowing by inertial-scroll-decay-percent.
  inertial-scroll-velocity-threshold:
    type: int
    default: 10
    description: |
      Minimum velocity (in tenths of raw_px/ms) to trigger inertial scroll.
      0 = always trigger. 3 = 0.3 raw_px/ms (filters imperceptible lifts only).
      10 = 1.0 raw_px/ms (old default).
  inertial-scroll-decay-percent:
    type: int
    default: 5
    description: |
      Percent speed lost per animation frame. Lower = longer glide.

  circular-scroll:
    type: boolean
    description: |
      If a touch begins on the outer circular-scroll-rim-percent percentage of the touchpad, angular
      movement of the touch is interpreted as scrolling down (clockwise) or up (counter-clockwise).
  circular-scroll-rim-percent:
    type: int
    default: 10
    description: |
      Width of the outer ring of the touchpad that activates circular scroll when the touch starts there.
      A lower value reduces accicental activation during normal usage, but requires better targeting
      to activate.
      The default value is a good compromise that works for me.
  circular-scroll-width:
    type: int
    default: 1024
    description: |
      Width of the touchpad.
  circular-scroll-height:
    type: int
    default: 1024
    description: |
      Height of the touchpad.
    
  right-side-vertical-scroll:
    type: boolean
    description: |
      If a touch begins on the right right-side-vertical-scroll-percent percentage of the touchpad, vertical
      movement of the touch is interpreted as vertical scrolling.
  right-side-vertical-scroll-percent:
    type: int
    default: 10
    description: |
      Width of the right part of the touchpad that activates vertical scroll when the touch starts there.
      A lower value reduces accicental activation during normal usage, but requires better targeting
      to activate.
      The default value is a good compromise that works for me.
    
  top-side-horizontal-scroll:
    type: boolean
    description: |
      If a touch begins on the top top-side-horizontal-scroll-percent percentage of the touchpad, horizontal
      movement of the touch is interpreted as horizontal scrolling
  top-side-horizontal-scroll-percent:
    type: int
    default: 10
    description: |
      Height of the upper part of the touchpad that activates horizontal scroll when the touch starts there.
      A lower value reduces accicental activation during normal usage, but requires better targeting
      to activate.
      The default value is a good compromise that works for me.

  wait-for-new-position-ms:
    type: int
    default: 30
    description: |
      The time it takes the touchpad to generate a new position in normal usage.
      Lower values result in better detection when a touch ends, but might trigger accidental
      taps or other gesture if a new position gets reported after the wait-for-new-position-ms 
      while the current touch is ongoing.
      Since Cirque Glidepoint touchpads report around every 10 ms, and some overhead to account
      for intense usage, the default value allows reliable tap detection while being quick enough that
      I can't notice it.
```

## dts/bindings/zmk,kscan-touch-detect.yaml
```yaml
description: |
  Virtual keyboard scan device driven by the peripheral_gesture processor.
  Reports a single key at (row=0, col=0) on touch start/end.
  Wire into zmk,kscan-composite so the touch key looks like any real key.

compatible: "zmk,kscan-touch-detect"

include: base.yaml
```

## src/Kconfig
```kconfig
# Copyright (c) 2022 The ZMK Contributors
# SPDX-License-Identifier: MIT

DT_COMPAT_ZMK_INPUT_PROCESSOR_GESTURES := zmk,input-processor-gestures

config ZMK_INPUT_PROCESSOR_GESTURES
		bool
		default $(dt_compat_enabled,$(DT_COMPAT_ZMK_INPUT_PROCESSOR_GESTURES))
        depends on ZMK_POINTING
        depends on (!ZMK_SPLIT || ZMK_SPLIT_ROLE_CENTRAL)

config INPUT_GESTURES_INIT_PRIORITY
    int "Touchpad gestures initialization priority"
    default INPUT_INIT_PRIORITY
    depends on ZMK_INPUT_PROCESSOR_GESTURES

DT_COMPAT_ZMK_INPUT_PERIPHERAL_GESTURE := zmk,input-peripheral-gesture

config ZMK_INPUT_PERIPHERAL_GESTURE
        bool
        default $(dt_compat_enabled,$(DT_COMPAT_ZMK_INPUT_PERIPHERAL_GESTURE))
        depends on ZMK_POINTING
        depends on (!ZMK_SPLIT || !ZMK_SPLIT_ROLE_CENTRAL)

config ZMK_INPUT_PERIPHERAL_GESTURE_WORKQ_STACK_SIZE
        int "Peripheral gesture work queue stack size"
        depends on ZMK_INPUT_PERIPHERAL_GESTURE
        default 2048

config ZMK_INPUT_PERIPHERAL_GESTURE_WORKQ_PRIORITY
        int "Peripheral gesture work queue thread priority"
        depends on ZMK_INPUT_PERIPHERAL_GESTURE
        default 5

DT_COMPAT_ZMK_KSCAN_TOUCH_DETECT := zmk,kscan-touch-detect

config ZMK_KSCAN_TOUCH_DETECT
        bool
        default $(dt_compat_enabled,$(DT_COMPAT_ZMK_KSCAN_TOUCH_DETECT))

config ZMK_HEARTBEAT_LED
        bool "Blink built-in LED as heartbeat (crash detection)"
        depends on GPIO
        help
          Blinks the led0 alias at 1 Hz. If blinking stops, the MCU crashed.
          If BLE drops but blinking continues, the fault is in the BLE link.
```
